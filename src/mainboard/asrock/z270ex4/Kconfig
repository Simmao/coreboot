## src/mainboard/asrock/z270ex4/Kconfig
```kconfig
if BOARD_ASROCK_Z270EX4

config BOARD_SPECIFIC_OPTIONS
	def_bool y
	select BOARD_ROMSIZE_KB_16384
	select HAVE_ACPI_RESUME
	select HAVE_ACPI_TABLES
	select HAVE_OPTION_TABLE
	select HAVE_CMOS_DEFAULT
	select INTEL_GMA_HAVE_VBT
	select INTEL_INT15
	select SOC_INTEL_KABYLAKE
	select SKYLAKE_SOC_PCH_H
	select SUPERIO_NUVOTON_COMMON_COM_A
	select SUPERIO_NUVOTON_NCT6791D
	select MEMORY_MAPPED_TPM
	select MAINBOARD_USES_IFD_GBE_REGION
	select MAINBOARD_HAS_LIBGFXINIT
	select SOC_INTEL_COMMON_BLOCK_HDA_VERB

config MAINBOARD_DIR
	default "asrock/z270ex4"

config MAINBOARD_VENDOR
	default "ASRock"

config MAINBOARD_PART_NUMBER
	default "Z270 Extreme4"

config PRERAM_CBMEM_CONSOLE_SIZE
	hex
	default 0xd00

config DIMM_SPD_SIZE
	default 512 #DDR4

endif
```

## src/mainboard/asus/p7h55-m_lx/Kconfig
```kconfig
if BOARD_ASUS_P7H55_M_LX

config BOARD_SPECIFIC_OPTIONS
	def_bool y
	select BOARD_ROMSIZE_KB_8192
	select SUPERIO_ITE_IT8718F
	select NORTHBRIDGE_INTEL_IRONLAKE
	select SOUTHBRIDGE_INTEL_IBEXPEAK
	#select HAVE_ACPI_RESUME
	#select HAVE_ACPI_TABLES
	#select HAVE_OPTION_TABLE
	#select HAVE_CMOS_DEFAULT
	select INTEL_GMA_HAVE_VBT
	select INTEL_INT15
	select MAINBOARD_HAS_LIBGFXINIT
	select SERIRQ_CONTINUOUS_MODE
	select USE_NATIVE_RAMINIT
	select NORTHBRIDGE_INTEL_IRONLAKE
	select SOUTHBRIDGE_INTEL_IBEXPEAK

config MAINBOARD_DIR
	default "asus/p7h55-m_lx"

config MAINBOARD_PART_NUMBER
	default "P7H55_M_LX"

config DRAM_RESET_GATE_GPIO
	default 28

endif
```

## src/mainboard/intel/dh67bl/Kconfig
```kconfig
## SPDX-License-Identifier: GPL-2.0-only

if BOARD_INTEL_DH67BL

config BOARD_SPECIFIC_OPTIONS
	def_bool y
	select BOARD_ROMSIZE_KB_4096
	select GFX_GMA_ANALOG_I2C_HDMI_B
	select HAVE_ACPI_RESUME
	select HAVE_ACPI_TABLES
	select HAVE_CMOS_DEFAULT
	select HAVE_OPTION_TABLE
	select INTEL_GMA_HAVE_VBT
	select MAINBOARD_HAS_LIBGFXINIT
	select NORTHBRIDGE_INTEL_SANDYBRIDGE
	select SERIRQ_CONTINUOUS_MODE
	select SOUTHBRIDGE_INTEL_BD82X6X
	select SUPERIO_WINBOND_W83667HG_A
	select USE_NATIVE_RAMINIT
	select MAINBOARD_USES_IFD_GBE_REGION

config MAINBOARD_DIR
	default "intel/dh67bl"

config MAINBOARD_PART_NUMBER
	default "DH67BL"

endif
```

## src/mainboard/positivo/Kconfig
```kconfig
if VENDOR_POSITIVO

choice
	prompt "Mainboard model"

source "src/mainboard/positivo/*/Kconfig.name"

endchoice

source "src/mainboard/positivo/*/Kconfig"

config MAINBOARD_VENDOR
	string
	default "POSITIVO"

endif # VENDOR_POSITIVO
```

## src/mainboard/positivo/pos_pih67ch/Kconfig
```kconfig
if BOARD_POSITIVO_POS_PIH67CH

config BOARD_SPECIFIC_OPTIONS
	def_bool y
	select BOARD_ROMSIZE_KB_4096
	select HAVE_ACPI_RESUME
	select HAVE_ACPI_TABLES
	select HAVE_CMOS_DEFAULT
	select HAVE_OPTION_TABLE
	select INTEL_GMA_HAVE_VBT
	select GFX_GMA_ANALOG_I2C_HDMI_B
	#select INTEL_INT15
	select MAINBOARD_HAS_LIBGFXINIT
	select NORTHBRIDGE_INTEL_SANDYBRIDGE
	select SERIRQ_CONTINUOUS_MODE
	select SOUTHBRIDGE_INTEL_BD82X6X
	select USE_NATIVE_RAMINIT
	select MAINBOARD_USES_IFD_GBE_REGION
	select SUPERIO_ITE_IT8728F

config MAINBOARD_DIR
	string
	default "positivo/pos_pih67ch"

config MAINBOARD_PART_NUMBER
	string
	default "POS-PIH67CH"

config VGA_BIOS_ID
	string
	default "8086,0152"

config DRAM_RESET_GATE_GPIO # FIXME: check this
	int
	default 25

config USBDEBUG_HCD_INDEX # FIXME: check this
	int
	default 1

#config CBFS_SIZE
#	default 0x200000
endif
```
